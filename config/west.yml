## config/west.yml
```yaml
manifest:
  remotes:
    - name: zmkfirmware
      url-base: https://github.com/zmkfirmware
    - name: englmaxi
      url-base: https://github.com/englmaxi
    - name: infused-kim
      url-base: https://github.com/infused-kim
    - name: vlasis
      url-base: https://github.com/VlasisMentz
  projects:
    # ZMK fork that includes mouse PR #2027 (zmk/mouse/types.h etc.) and is
    # verified compatible with the infused-kim PS/2 driver module.
    # "pr-testing/mouse_ps2_module_base" is infused-kim's "last known to work"
    # stable base; switch to petejohanson/feat/pointers-move-scroll for the
    # bleeding edge, or urob/zmk (+ CONFIG_ZMK_INPUT_MOUSE_PS2_ENABLE_UROB_COMPAT=y)
    # for urob's extended feature set.
    - name: zmk
      remote: infused-kim
      revision: pr-testing/mouse_ps2_module_base
      import: app/west.yml
    - name: zmk-dongle-display
      remote: englmaxi
      revision: v0.3
    # PS/2 TrackPoint driver module — forked to add SCL pin state debug logging.
    # Switch back to `remote: infused-kim / revision: main` once debugging is done.
    - name: kb_zmk_ps2_mouse_trackpoint_driver
      remote: vlasis
      revision: debug-logging
  self:
    path: config
```
